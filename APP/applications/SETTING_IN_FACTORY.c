#include "Lib_LCD_kernel.h"
#include "Lib_LCD_menu.h"
#include "SETTING_IN_FACTORY.h"

uint8 setting_in_factory_menu_array[]=
{
	CHANNEL_FACTOR,        FULL_RANGE_SETTING,
    OPEN_INTO_CONFIGURE,   OPEN_OUT_CONFIGURE,
    PROTECTION_CONFIGURE,  OPEN_INTO_TEST,
    FACTORY_RESET,
};

uint8_t channel_factor[]={
0x11,0xF2,0x00,0xF9,0xA9,0xAB,0xFD,0xAD,0xAB,0xF8,0x00,0x00,
0x08,0x07,0x08,0x0B,0x08,0x08,0x0B,0x08,0x0A,0x0B,0x08,0x00,/*"通",0*/
0x10,0x11,0xF2,0x00,0xFA,0xAB,0xAE,0xAA,0xAA,0xAB,0xFA,0x00,
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0x09,0x0B,0x05,0x05,0x0B,0x00,0x08,0x05,0x02,0x05,0x08,0x00,/*"数",3*/
};
uint8_t full_range_setting[]={
0x22,0x44,0xD2,0x52,0x57,0xF2,0x52,0xF2,0x57,0x52,0xD2,0x00,
0x04,0x02,0x0F,0x00,0x02,0x01,0x02,0x01,0x02,0x08,0x0F,0x00,/*"满",0*/
0x00,0xFE,0x0A,0x8A,0xBE,0xAA,0xAB,0xAA,0xBE,0x8A,0x0A,0x00,
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0x08,0x08,0x0F,0x08,0x08,0x0E,0x08,0x08,0x0F,0x08,0x08,0x00,/*"置",3*/
};
uint8_t open_into_configure[]={
0x40,0x42,0x42,0xFE,0x42,0x42,0x42,0xFE,0x42,0x42,0x40,0x00,
0x00,0x08,0x06,0x01,0x00,0x00,0x00,0x0F,0x00,0x00,0x00,0x00,/*"开",0*/
0x00,0x00,0x01,0x81,0x72,0x0C,0x70,0x80,0x00,0x00,0x00,0x00,
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0x08,0x08,0x0F,0x08,0x08,0x0E,0x08,0x08,0x0F,0x08,0x08,0x00,/*"置",3*/
};
uint8_t open_out_configure[]={
0x40,0x42,0x42,0xFE,0x42,0x42,0x42,0xFE,0x42,0x42,0x40,0x00,
0x00,0x08,0x06,0x01,0x00,0x00,0x00,0x0F,0x00,0x00,0x00,0x00,/*"开",0*/
0x80,0x1E,0x10,0x10,0x10,0xFF,0x10,0x10,0x10,0x1E,0x80,0x00,
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0x08,0x08,0x0F,0x08,0x08,0x0E,0x08,0x08,0x0F,0x08,0x08,0x00,/*"置",3*/
};
uint8_t protection_configure[]={
0x20,0x10,0xFC,0x03,0x40,0x5E,0x52,0xF2,0x52,0x5E,0x40,0x00,
0x00,0x00,0x0F,0x00,0x04,0x02,0x01,0x0F,0x01,0x02,0x04,0x00,/*"保",0*/
0x88,0x88,0xFF,0x48,0x00,0xFC,0x44,0x45,0x46,0x44,0xFC,0x00,
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0x08,0x08,0x0F,0x08,0x08,0x0E,0x08,0x08,0x0F,0x08,0x08,0x00,/*"置",3*/
};
uint8_t open_into_test[]={
0x40,0x42,0x42,0xFE,0x42,0x42,0x42,0xFE,0x42,0x42,0x40,0x00,
0x00,0x08,0x06,0x01,0x00,0x00,0x00,0x0F,0x00,0x00,0x00,0x00,/*"开",0*/
0x80,0x1E,0x10,0x10,0x10,0xFF,0x10,0x10,0x10,0x1E,0x80,0x00,
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0x00,0x0F,0x04,0x00,0x04,0x07,0x02,0x00,0x03,0x04,0x0E,0x00,/*"试",3*/
};
uint8_t factory_reset[]={
0x80,0x1E,0x10,0x10,0x10,0xFF,0x10,0x10,0x10,0x1E,0x80,0x00,
0x07,0x04,0x04,0x04,0x04,0x07,0x04,0x04,0x04,0x04,0x0F,0x00,/*"出",0*/
0x00,0xFE,0x02,0x02,0x02,0x02,0x02,0x02,0x02,0x02,0x02,0x00,
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0x00,0x0A,0x09,0x0B,0x05,0x05,0x05,0x05,0x0B,0x09,0x08,0x00,/*"复",3*/
};

enum full_range_setting_menu_type{
	DW_PT_FULL_RANGE,
	FD_PT_FULL_RANGE,
	BH_CT_FULL_RANGE,
	LX_CT_FULL_RANGE,
};
uint8 full_range_setting_menu_array[]={
	DW_PT_FULL_RANGE,
	FD_PT_FULL_RANGE,
	BH_CT_FULL_RANGE,
	LX_CT_FULL_RANGE,
};
enum factory_reset_menu_type{
	FIX_VALUE_RESET,
	ALL_VALUE_RESET,
	COUNT_CLEAR,
};
uint8 factory_reset_menu_array[]={
	FIX_VALUE_RESET,
	ALL_VALUE_RESET,
	COUNT_CLEAR,
};

uint8_t dw_pt_full_range[]={
0xFC,0x24,0x24,0x24,0xFF,0x24,0x24,0x24,0xFC,0x00,0x00,0x00,
0x03,0x01,0x01,0x01,0x07,0x09,0x09,0x09,0x09,0x08,0x0E,0x00,/*"电",0*/
0xFF,0x09,0x91,0x61,0x91,0x09,0x91,0x61,0x91,0x09,0xFF,0x00,
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0x00,0x0F,0x00,0x08,0x0F,0x0A,0x0A,0x0A,0x0A,0x0F,0x08,0x00,/*"值",6*/
};
uint8_t fd_pt_full_range[]={
0x0E,0x08,0x88,0x78,0xCF,0x48,0x48,0x49,0xCA,0x08,0x08,0x00,
0x04,0x02,0x09,0x08,0x04,0x05,0x02,0x05,0x04,0x08,0x08,0x00,/*"发",0*/
0xFC,0x24,0x24,0x24,0xFF,0x24,0x24,0x24,0xFC,0x00,0x00,0x00,
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0x00,0x0F,0x00,0x08,0x0F,0x0A,0x0A,0x0A,0x0A,0x0F,0x08,0x00,/*"值",6*/
};
uint8_t bh_ct_full_range[]={
0x20,0x10,0xFC,0x03,0x40,0x5E,0x52,0xF2,0x52,0x5E,0x40,0x00,
0x00,0x00,0x0F,0x00,0x04,0x02,0x01,0x0F,0x01,0x02,0x04,0x00,/*"保",0*/
0x88,0x88,0xFF,0x48,0x00,0xFC,0x44,0x45,0x46,0x44,0xFC,0x00,
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0x00,0x0F,0x00,0x08,0x0F,0x0A,0x0A,0x0A,0x0A,0x0F,0x08,0x00,/*"值",6*/
};
uint8_t lx_ct_full_range[]={
0x0C,0x25,0xAD,0xAD,0x45,0xBF,0x45,0xAD,0xAD,0x25,0x0C,0x00,
0x01,0x01,0x00,0x05,0x05,0x05,0x0B,0x09,0x00,0x01,0x01,0x00,/*"零",0*/
0x00,0xFE,0x82,0x8A,0xAA,0xAA,0xCB,0xAA,0x9A,0x8A,0x82,0x00,
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0x00,0x0F,0x00,0x08,0x0F,0x0A,0x0A,0x0A,0x0A,0x0F,0x08,0x00,/*"值",6*/
};

uint8_t key_enter_working2[]={
0x88,0x88,0xFF,0x48,0x00,0x4C,0xC4,0x75,0x46,0xC4,0x4C,0x00,
0x00,0x08,0x0F,0x00,0x08,0x08,0x05,0x02,0x02,0x05,0x08,0x00,/*"按",0*/
0x42,0xF2,0x2E,0xE2,0x00,0xF4,0x53,0xF2,0x5A,0x56,0xF0,0x00,
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0x00,0x00,0x0F,0x00,0x00,0x00,0x08,0x08,0x0F,0x00,0x00,0x00,/*"行",5*/
};

uint8_t fix_value_reset[]={
0x2C,0x24,0xA4,0x24,0x25,0xE6,0x24,0x24,0x24,0x24,0x2C,0x00,
0x08,0x04,0x03,0x04,0x08,0x0F,0x09,0x09,0x09,0x09,0x08,0x00,/*"定",0*/
0x10,0xFC,0x03,0x00,0xFA,0xAA,0xAF,0xAA,0xAA,0xFA,0x02,0x00,
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0x00,0x0A,0x09,0x0B,0x05,0x05,0x05,0x05,0x0B,0x09,0x08,0x00,/*"复",5*/
};
uint8_t all_value_reset[]={
0x10,0x10,0x28,0x24,0x22,0xE1,0x22,0x24,0x28,0x10,0x10,0x00,
0x08,0x09,0x09,0x09,0x09,0x0F,0x09,0x09,0x09,0x09,0x08,0x00,/*"全",0*/
0x20,0xAA,0xB2,0xA3,0xB2,0xAA,0x20,0xFE,0x02,0x32,0xCE,0x00,
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0x00,0x0A,0x09,0x0B,0x05,0x05,0x05,0x05,0x0B,0x09,0x08,0x00,/*"复",5*/
};
uint8_t count_clear[]={
0xFC,0x24,0x24,0x24,0xFF,0x24,0x24,0x24,0xFC,0x00,0x00,0x00,
0x03,0x01,0x01,0x01,0x07,0x09,0x09,0x09,0x09,0x08,0x0E,0x00,/*"电",0*/
0x08,0xFF,0xA9,0xA9,0xA9,0xFB,0xAD,0xA9,0xA9,0xFF,0x08,0x00,
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0x01,0x01,0x00,0x05,0x05,0x05,0x0B,0x09,0x00,0x01,0x01,0x00,/*"零",5*/
};

struct menu_event_tag * setting_in_factory_handler(uint8_t msg_process_signal, uint8_t msg_context)
{
	/* msg_evt should be malloced and return it! */
	struct menu_event_tag *menu_evt = (struct menu_event_tag *)malloc(sizeof(struct menu_event_tag));
	menu_evt->status = EVT_NO_ERROR;
	menu_evt->msg_operation = MSG_RESUMED;

	if(msg_process_signal == 1)
	{
		uint8_t menu_type_idx = menu_type_ptr_match(msg_context, 4, 2, sizeof(setting_in_factory_menu_array));
		Log_d("menu_type_idx:%d \r\n", menu_type_idx);

		if(msg_context == KEY_ENTER)
		{
			menu_level_from_env_set(TOP_NODE_MENU, SETTING_IN_FACTORY, setting_in_factory_menu_array[menu_type_idx]);
            msg_send_to_lcd_layer(LCD_LAYER, LCD_LAYER, MSG_AVAILABLE, FLUSH_SCREEN);
			cur_menu_type_ptr_from_env_set(0);
			menu_kernel_env.menu_cursor_history.first_menu_cursor = menu_type_idx;
			Log_d("key KEY_ENTER menu!\r\n");
		}

		if(msg_context == KEY_RETURN)
		{
			menu_level_from_env_set(TOP_NODE_MENU, UNKNOW_SECOND_MENU, UNKNOW_THIRD_MENU);
            msg_send_to_lcd_layer(LCD_LAYER, LCD_LAYER, MSG_AVAILABLE, FLUSH_SCREEN);
			cur_menu_type_ptr_from_env_set(menu_kernel_env.menu_cursor_history.top_menu_cursor);
			Log_d("key KEY_RETURN menu!\r\n");
		}

        if(msg_context == FLUSH_SCREEN)
        {
			Log_d("\r\n    \r\n");
            clear_screen();
			msg_context = 0xff;
			msg_lock_from_env_set(0);//unlock the msg
        }
        switch(msg_context)
		{
			case	0xff:
			case    KEY_UP:
    		case	KEY_DOWN:		
    		case	KEY_LEFT:
			case	KEY_RIGHT:
				clear_screen();
				LCD_ShowChinese_garland(0, 0, setting_in_factory, 4);
				switch(setting_in_factory_menu_array[menu_type_idx])
				{
					case CHANNEL_FACTOR:
						LCD_ShowChinese_no_garland(8, 13, channel_factor, 4);
						LCD_ShowChinese_garland(8, 26, open_into_configure, 4);
						LCD_ShowChinese_garland(8, 38, protection_configure, 4);
                        LCD_ShowChinese_garland(8, 51, factory_reset, 4);

						LCD_ShowChinese_garland(64, 13, full_range_setting, 4);
						LCD_ShowChinese_garland(64, 26, open_out_configure, 4);
						LCD_ShowChinese_garland(64, 38, open_into_test, 4);
						break;
                    case FULL_RANGE_SETTING:
						LCD_ShowChinese_garland(8, 13, channel_factor, 4);
						LCD_ShowChinese_garland(8, 26, open_into_configure, 4);
						LCD_ShowChinese_garland(8, 38, protection_configure, 4);
                        LCD_ShowChinese_garland(8, 51, factory_reset, 4);

						LCD_ShowChinese_no_garland(64, 13, full_range_setting, 4);
						LCD_ShowChinese_garland(64, 26, open_out_configure, 4);
						LCD_ShowChinese_garland(64, 38, open_into_test, 4);
						break;
                    case OPEN_INTO_CONFIGURE:
						LCD_ShowChinese_garland(8, 13, channel_factor, 4);
						LCD_ShowChinese_no_garland(8, 26, open_into_configure, 4);
						LCD_ShowChinese_garland(8, 38, protection_configure, 4);
                        LCD_ShowChinese_garland(8, 51, factory_reset, 4);

						LCD_ShowChinese_garland(64, 13, full_range_setting, 4);
						LCD_ShowChinese_garland(64, 26, open_out_configure, 4);
						LCD_ShowChinese_garland(64, 38, open_into_test, 4);
						break;
                    case OPEN_OUT_CONFIGURE:
						LCD_ShowChinese_garland(8, 13, channel_factor, 4);
						LCD_ShowChinese_garland(8, 26, open_into_configure, 4);
						LCD_ShowChinese_garland(8, 38, protection_configure, 4);
                        LCD_ShowChinese_garland(8, 51, factory_reset, 4);

						LCD_ShowChinese_garland(64, 13, full_range_setting, 4);
						LCD_ShowChinese_no_garland(64, 26, open_out_configure, 4);
						LCD_ShowChinese_garland(64, 38, open_into_test, 4);
						break;
                    case PROTECTION_CONFIGURE:
						LCD_ShowChinese_garland(8, 13, channel_factor, 4);
						LCD_ShowChinese_garland(8, 26, open_into_configure, 4);
						LCD_ShowChinese_no_garland(8, 38, protection_configure, 4);
                        LCD_ShowChinese_garland(8, 51, factory_reset, 4);

						LCD_ShowChinese_garland(64, 13, full_range_setting, 4);
						LCD_ShowChinese_garland(64, 26, open_out_configure, 4);
						LCD_ShowChinese_garland(64, 38, open_into_test, 4);
						break;
                    case OPEN_INTO_TEST:
						LCD_ShowChinese_garland(8, 13, channel_factor, 4);
						LCD_ShowChinese_garland(8, 26, open_into_configure, 4);
						LCD_ShowChinese_garland(8, 38, protection_configure, 4);
                        LCD_ShowChinese_garland(8, 51, factory_reset, 4);

						LCD_ShowChinese_garland(64, 13, full_range_setting, 4);
						LCD_ShowChinese_garland(64, 26, open_out_configure, 4);
						LCD_ShowChinese_no_garland(64, 38, open_into_test, 4);
						break;
                    case FACTORY_RESET:
						LCD_ShowChinese_garland(8, 13, channel_factor, 4);
						LCD_ShowChinese_garland(8, 26, open_into_configure, 4);
						LCD_ShowChinese_garland(8, 39, protection_configure, 4);
                        LCD_ShowChinese_no_garland(8, 51, factory_reset, 4);

						LCD_ShowChinese_garland(64, 13, full_range_setting, 4);
						LCD_ShowChinese_garland(64, 26, open_out_configure, 4);
						LCD_ShowChinese_garland(64, 38, open_into_test, 4);
						break;

					
				}
				break;
			default:
				break;
		}
	}

	return menu_evt;
}
struct menu_event_tag * full_range_setting_handler(uint8_t msg_process_signal, uint8_t msg_context)
{
	/* msg_evt should be malloced and return it! OVER_VOLTAGE_PROTECTION*/
	struct menu_event_tag *menu_evt = (struct menu_event_tag *)malloc(sizeof(struct menu_event_tag));
	menu_evt->status = EVT_NO_ERROR;
	menu_evt->msg_operation = MSG_RESUMED;

	/* Please enter user password with USER_PASSWORD_AUTHENTICATE() */
	uint8_t authentication_key =  USER_PASSWORD_AUTHENTICATE();
    if(authentication_key)
	{
		Log_d("\r\n    \r\n");
		return menu_evt;
	}

    if(msg_process_signal == 1)
	{	
		uint8_t menu_type_idx = menu_type_ptr_match(msg_context, 4, 1, sizeof(full_range_setting_menu_array));
		Log_d("menu_type_idx:%d \r\n", menu_type_idx);

		if(msg_context == KEY_RETURN)
		{
			menu_level_from_env_set(TOP_NODE_MENU, SETTING_IN_FACTORY, UNKNOW_THIRD_MENU);
            msg_send_to_lcd_layer(LCD_LAYER, LCD_LAYER, MSG_AVAILABLE, FLUSH_SCREEN);
			cur_menu_type_ptr_from_env_set(menu_kernel_env.menu_cursor_history.first_menu_cursor);
			Log_d("key KEY_RETURN menu!\r\n");
		}
        if(msg_context == FLUSH_SCREEN)
        {
			Log_d("\r\n    \r\n");
            clear_screen();
			msg_context = 0xff;
			msg_lock_from_env_set(0);//unlock the msg
        }
		switch(msg_context)
		{
			case	0xff:
			case    KEY_UP:
    		case	KEY_DOWN:		
    		case	KEY_LEFT:
			case	KEY_RIGHT:
				clear_screen();
				LCD_ShowChinese_garland(0, 0, full_range_setting, 4);
				switch(full_range_setting_menu_array[menu_type_idx])
				{
					case DW_PT_FULL_RANGE:
						LCD_ShowChinese_no_garland(8, 13, dw_pt_full_range, 6);
						LCD_ShowChinese_garland(8, 26, fd_pt_full_range, 6);
						LCD_ShowChinese_garland(8, 38, bh_ct_full_range, 6);
						LCD_ShowChinese_garland(8, 51, lx_ct_full_range, 6);
						break;
					case FD_PT_FULL_RANGE:
						LCD_ShowChinese_garland(8, 13, dw_pt_full_range, 6);
						LCD_ShowChinese_no_garland(8, 26, fd_pt_full_range, 6);
						LCD_ShowChinese_garland(8, 38, bh_ct_full_range, 6);
						LCD_ShowChinese_garland(8, 51, lx_ct_full_range, 6);
						break;
					case BH_CT_FULL_RANGE:
						LCD_ShowChinese_garland(8, 13, dw_pt_full_range, 6);
						LCD_ShowChinese_garland(8, 26, fd_pt_full_range, 6);
						LCD_ShowChinese_no_garland(8, 38, bh_ct_full_range, 6);
						LCD_ShowChinese_garland(8, 51, lx_ct_full_range, 6);
						break;
					case LX_CT_FULL_RANGE:
						LCD_ShowChinese_garland(8, 13, dw_pt_full_range, 6);
						LCD_ShowChinese_garland(8, 26, fd_pt_full_range, 6);
						LCD_ShowChinese_garland(8, 38, bh_ct_full_range, 6);
						LCD_ShowChinese_no_garland(8, 51, lx_ct_full_range, 6);
						break;
				}
				break;
			default:
				break;
		}
    }

    return menu_evt;
}
struct menu_event_tag * factory_reset_handler(uint8_t msg_process_signal, uint8_t msg_context)
{
	/* msg_evt should be malloced and return it! OVER_VOLTAGE_PROTECTION*/
	struct menu_event_tag *menu_evt = (struct menu_event_tag *)malloc(sizeof(struct menu_event_tag));
	menu_evt->status = EVT_NO_ERROR;
	menu_evt->msg_operation = MSG_RESUMED;

	/* Please enter user password with USER_PASSWORD_AUTHENTICATE() */
	uint8_t authentication_key =  USER_PASSWORD_AUTHENTICATE();
    if(authentication_key)
	{
		Log_d("\r\n    \r\n");
		return menu_evt;
	}

    if(msg_process_signal == 1)
	{	
		uint8_t menu_type_idx = menu_type_ptr_match(msg_context, 3, 1, sizeof(factory_reset_menu_array));
		Log_d("menu_type_idx:%d \r\n", menu_type_idx);

		if(msg_context == KEY_RETURN)
		{
			menu_level_from_env_set(TOP_NODE_MENU, SETTING_IN_FACTORY, UNKNOW_THIRD_MENU);
            msg_send_to_lcd_layer(LCD_LAYER, LCD_LAYER, MSG_AVAILABLE, FLUSH_SCREEN);
			cur_menu_type_ptr_from_env_set(menu_kernel_env.menu_cursor_history.first_menu_cursor);
			Log_d("key KEY_RETURN menu!\r\n");
		}
        if(msg_context == FLUSH_SCREEN)
        {
			Log_d("\r\n    \r\n");
            clear_screen();
			msg_context = 0xff;
			msg_lock_from_env_set(0);//unlock the msg
        }
		switch(msg_context)
		{
			case	0xff:
			case    KEY_UP:
    		case	KEY_DOWN:		
    		case	KEY_LEFT:
			case	KEY_RIGHT:
				clear_screen();
				LCD_ShowChinese_garland(0, 0, factory_reset, 4);
				switch(factory_reset_menu_array[menu_type_idx])
				{
					case FIX_VALUE_RESET:
						LCD_ShowChinese_no_garland(8, 13, fix_value_reset, 6);
						LCD_ShowChinese_garland(8, 26, all_value_reset, 6);
						LCD_ShowChinese_garland(8, 38, count_clear, 6);
						LCD_ShowChinese_garland(24, 51, key_enter_working2, 6);
						break;
					case ALL_VALUE_RESET:
						LCD_ShowChinese_garland(8, 13, fix_value_reset, 6);
						LCD_ShowChinese_no_garland(8, 26, all_value_reset, 6);
						LCD_ShowChinese_garland(8, 38, count_clear, 6);
						LCD_ShowChinese_garland(24, 51, key_enter_working2, 6);
						break;
					case COUNT_CLEAR:
						LCD_ShowChinese_garland(8, 13, fix_value_reset, 6);
						LCD_ShowChinese_garland(8, 26, all_value_reset, 6);
						LCD_ShowChinese_no_garland(8, 38, count_clear, 6);
						LCD_ShowChinese_garland(24, 51, key_enter_working2, 6);
						break;
				}
				break;
			default:
				break;
		}
    }

    return menu_evt;
}
